## CMakeLists.txt
```
cmake_minimum_required(VERSION 3.20.0)
find_package(Zephyr REQUIRED HINTS $ENV{ZEPHYR_BASE})

project(grtc_wakeup)

target_sources(app PRIVATE src/main.c)
```

## prj.conf
```kconfig
// Sleep / Wakeup via GRTC
CONFIG_NRFX_GRTC=y
CONFIG_PM_DEVICE=y
CONFIG_POWEROFF=y

// Printing to screen
CONFIG_LOG=y

// LED Control on nPM1300
CONFIG_LED=y
CONFIG_LED_NPM13XX=y

// Disable IMU
CONFIG_LSM6DSL=n
```

## boards/app.overlay
```dts
/* Disable unused LDO1 that powers IMU/MIC  */
&pmic {
    regulators {
        LDO1 {
            /delete-property/ regulator-boot-on;
        };
    };
};

// Allow nPM1300 LED1 to be changed to save power
&pmic_leds {
    status = "okay";
    nordic,led1-mode = "host";
};
```

## src/main.c
```c
#include <zephyr/kernel.h>
#include <zephyr/drivers/timer/nrf_grtc_timer.h>        // z_nrf_grtc_wakeup_prepare()
#include <zephyr/logging/log_ctrl.h>                    // log_panic()
#include <zephyr/sys/poweroff.h>                        // sys_poweroff()
#include <zephyr/drivers/led.h>                         // led_off()

#define WAIT_TIME_SECS 10

int main(void)
{
        // Turn off the power / charge LED
        const struct device *leds = DEVICE_DT_GET(DT_NODELABEL(pmic_leds));
        led_off(leds, 1);

        printk("Awake\n");
        // Wait 10 secs
        k_msleep(WAIT_TIME_SECS * MSEC_PER_SEC);

        // Prepare to wake up in 10 secs
        int err = z_nrf_grtc_wakeup_prepare(WAIT_TIME_SECS * USEC_PER_SEC);
        if (err < 0) {
		printk("Error: GRTC wakeup prepare failed: %d\n", err);
		return 0;
	} else {
		printk("Success: GRTC wakeup prepared. Powering off...\n");
	}

        // Force logging to flush to allow GRTC / Poweroff
        // Credit to https://github.com/kemegard/generic_grtc
        log_panic();

        // Power off
        sys_poweroff();

        // Should never get here
        return 0;
}
```
